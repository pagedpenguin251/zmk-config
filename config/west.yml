## config/west.yml
```yaml
manifest:
  remotes:
    - name: pagedpenguin251
      url-base: https://github.com/pagedpenguin251
    - name: m165437
      url-base: https://github.com/M165437
  projects:
    - name: zmk
      remote: pagedpenguin251
      revision: plover
      import: app/west.yml
    # include corne with dongle pro_micro and xiao compatible
    - name: nice-view-gem
      remote: m165437
      revision: main
      # - name: zmk-nice-oled
      # remote: mctechnology17
      # revision: main
  self:
    path: config
```
